## package/kernel/hello/src/Kconfig
```kconfig
config hello
　　tristate "first driver hello"
　　default n
　　help
　　　This is my first test driver
```

## package/kernel/netlink-k/src/Kconfig
```kconfig
config netlink-k
　　tristate "netlink test driver"
　　default n
　　help
　　　netlink test driver
```

## package/kernel/sds1302/src/Kconfig
```kconfig
config SDS1302
　　tristate "ported DS1302"
　　default y
　　help
　　　This is ds1302 rtc driver for platform ap143.
```
